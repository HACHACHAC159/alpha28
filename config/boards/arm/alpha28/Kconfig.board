## config/boards/arm/alpha28/Kconfig.defconfig
```kconfig
if BOARD_ALPHA28

config ZMK_KEYBOARD_NAME
	default "Alpha28"

if USB_DEVICE_STACK

config USB_NRFX
    default y

endif # USB_DEVICE_STACK

config BT_CTLR
	default BT

config ZMK_BLE
	default y

config ZMK_USB
	default y

endif # 
```
